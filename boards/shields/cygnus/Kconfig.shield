## boards/shields/cygnus/Kconfig.shield
```kconfig
config SHIELD_CYGNUS_LEFT
    def_bool $(shields_list_contains,cygnus_left)

config SHIELD_CYGNUS_RIGHT
    def_bool $(shields_list_contains,cyngus_right)

config SHIELD_CYGNUS_DONGLE 
    def_bool $(shields_list_contains,cyngus_dongle)
```
