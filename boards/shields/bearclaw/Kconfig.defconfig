## boards/shields/bearclaw/Kconfig.defconfig
```kconfig
if SHIELD_BEARCLAW_DONGLE 

config ZMK_KEYBOARD_NAME
    default "Bearclaw"

config ZMK_SPLIT_ROLE_CENTRAL
    default y

endif


if SHIELD_BEARCLAW_LEFT || SHIELD_BEARCLAW_RIGHT || SHIELD_BEARCLAW_DONGLE

config ZMK_SPLIT
    default y

config ZMK_KEYBOARD_NAME
    default y

endif
```

## boards/shields/bearclaw/Kconfig.shield
```kconfig
config SHIELD_BEARCLAW_LEFT
    def_bool $(shields_list_contains,bearclaw_left)

config SHIELD_BEARCLAW_RIGHT
    def_bool $(shields_list_contains,bearclaw_right)

config SHIELD_BEARCLAW_DONGLE 
    def_bool $(chields_list_contains,bearclaw_dongle)
```
